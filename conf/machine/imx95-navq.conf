## conf/machine/imx95-navqbdesktop.conf
```bitbake
MACHINE = "imx95-navqb"
require conf/machine/imx95-navq.conf

require conf/machine/include/ubuntubasics.inc
```

## conf/machine/imx95-navqdesktop.conf
```bitbake
require conf/machine/imx95-navq.conf

require conf/machine/include/ubuntubasics.inc
```
